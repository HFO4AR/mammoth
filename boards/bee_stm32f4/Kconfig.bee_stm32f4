## boards/bee_stm32f4/Kconfig.bee_stm32f4
```kconfig
# Copyright (c) 2025 Your Company
# SPDX-License-Identifier: Apache-2.0

config BOARD_BEE_STM32F4
    bool "BEE STM32F4 board (STM32F407xx)"
    select SOC_STM32F407XE
    help
      Support for the BEE STM32F4 board with STM32F407ZET6 microcontroller
```

## boards/bee_stm32f4/Kconfig.defconfig
```kconfig
# Copyright (c) 2025 Your Company
# SPDX-License-Identifier: Apache-2.0

if BOARD_BEE_STM32F4
config SOC
    default "stm32f407xx"

config SOC_SERIES
    default "stm32f4x"

config BOARD
    default "bee_stm32f4"

endif # BOARD_BEE_STM32F4
```

## boards/bee_stm32f4/board.yml
```yaml
board:
  name: bee_stm32f4
  full_name: BEE STM32F4
  vendor: bee
  socs:
    - name: stm32f407xx
```
